## CMakeLists.txt
```
# SPDX-License-Identifier: Apache-2.0

set(DTC_OVERLAY_FILE src/usb-midi.dts)

list(APPEND ZEPHYR_EXTRA_MODULES ${CMAKE_CURRENT_SOURCE_DIR}/../usb_midi)

cmake_minimum_required(VERSION 3.20)
find_package(Zephyr REQUIRED HINTS $ENV{ZEPHYR_BASE})
project(midi-loopback)

target_sources(app PRIVATE src/main.c)
```

## prj.conf
```kconfig
CONFIG_GPIO=y

CONFIG_LOG=y
CONFIG_LOG_MODE_IMMEDIATE=y

CONFIG_USB_DEVICE_STACK=y
CONFIG_USB_DEVICE_MANUFACTURER="iTitou"
CONFIG_USB_DEVICE_PRODUCT="MIDI loopback"

CONFIG_USB_DEVICE_MIDI=y
# CONFIG_USB_MIDI_LOG_LEVEL_DBG=y
```

## src/main.c
```c
#include <math.h>
#include <stdio.h>

#include <zephyr/drivers/uart.h>
#include <zephyr/kernel.h>
#include <zephyr/logging/log.h>
#include <zephyr/usb/usb_device.h>

LOG_MODULE_REGISTER(main, LOG_LEVEL_INF);

static const struct device *const midi_in = DEVICE_DT_GET(DT_NODELABEL(midi_in));
static const struct device *const midi_out = DEVICE_DT_GET(DT_NODELABEL(midi_out));


void main()
{
	uint8_t databyte;

	int ret = usb_enable(NULL);
	if (ret != 0) {
		LOG_ERR("Failed to enable USB");
		return;
	}

	LOG_INF("USB enabled");

	while (1){
		if (uart_poll_in(midi_out, &databyte) == 0){
			uart_poll_out(midi_in, databyte);
		} else {
			k_sleep(K_MSEC(1));
		}
	}
}
```
