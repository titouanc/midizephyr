## kinesta_hw/Kconfig
```kconfig
# Copyright (c) 2021 Titouan Christophe
# SPDX-License-Identifier: Apache-2.0

config KINESTA_HW
    bool "Enable support for Kinesta hardware modules"
    select I2C

if KINESTA_HW

choice "KINESTA_HW_LOG_LEVEL_CHOICE"
    prompt "Max compiled-in log level for USB MIDI function"
    default KINESTA_HW_LOG_LEVEL_INF
    depends on LOG

config KINESTA_HW_LOG_LEVEL_OFF
    bool "Off"

config KINESTA_HW_LOG_LEVEL_ERR
    bool "Error"

config KINESTA_HW_LOG_LEVEL_WRN
    bool "Warning"

config KINESTA_HW_LOG_LEVEL_INF
    bool "Info"

config KINESTA_HW_LOG_LEVEL_DBG
    bool "Debug"

endchoice

config KINESTA_HW_LOG_LEVEL
    int
    depends on LOG
    default 0 if KINESTA_HW_LOG_LEVEL_OFF
    default 1 if KINESTA_HW_LOG_LEVEL_ERR
    default 2 if KINESTA_HW_LOG_LEVEL_WRN
    default 3 if KINESTA_HW_LOG_LEVEL_INF
    default 4 if KINESTA_HW_LOG_LEVEL_DBG

config KINESTA_HW_ENCODER_STEPS
    int "Number of steps in the encoder range"
    default 32

endif
```

## kinesta_hw/dts/bindings/duppa,i2cencoderv21.yaml
```yaml
# Copyright (c) 2022 Titouan Christophe
# SPDX-License-Identifier: Apache-2.0

description: Duppa I2C Encoder V2.1
compatible: duppa,i2cencoderv21

include: i2c-device.yaml

properties:
    "#gpios-cells":
        type: int
        const: 1
    interrupt-gpios:
        type: phandle-array
        required: true
        description: gpio descriptor for the interrupt pin
```

## kinesta_hw/dts/bindings/kinesta,functional-block.yaml
```yaml
# Copyright (c) 2022 Titouan Christophe
# SPDX-License-Identifier: Apache-2.0

description: Kinesta functional block
compatible: kinesta,functional-block

include: base.yaml

properties:
    primary-touchpad:
        type: phandle
        required: true
    secondary-touchpad:
        type: phandle
        required: true
    encoder:
        type: phandle
        required: true
    distance-sensor:
        type: phandle
        required: true
    midi-cc-group:
        type: int
        required: true
```

## kinesta_hw/dts/bindings/kinesta,midi-din.yaml
```yaml
# Copyright (c) 2022 Titouan Christophe
# SPDX-License-Identifier: Apache-2.0

description: Kinesta MIDI DIN5 connector with LEDs
compatible: kinesta,midi-din

include: base.yaml

properties:
    "#gpio-cells":
        type: int
        const: 1
    uart:
        type: phandle
        required: true
    rx-led-gpios:
        type: phandle-array
        required: true
    tx-led-gpios:
        type: phandle-array
        required: true
```

## kinesta_hw/dts/bindings/kinesta,rgb-touchpad-gpio.yaml
```yaml
# Copyright (c) 2022 Titouan Christophe
# SPDX-License-Identifier: Apache-2.0

description: RGB Touchpad (GPIO - RGBYMCW)
compatible: kinesta,rgb-touchpad-gpio

include: base.yaml

properties:
    "#gpio-cells":
        type: int
        const: 1
    r-gpios:
        type: phandle-array
        required: true
        description: gpio descriptor for the red led
    g-gpios:
        type: phandle-array
        required: true
        description: gpio descriptor for the green led
    b-gpios:
        type: phandle-array
        required: true
        description: gpio descriptor for the blue led
    touch-gpios:
        type: phandle-array
        required: true
        description: gpio descriptor for the touch output
```

## kinesta_hw/dts/bindings/kinesta,rgb-touchpad-pwm.yaml
```yaml
# Copyright (c) 2022 Titouan Christophe
# SPDX-License-Identifier: Apache-2.0

description: RGB Touchpad (PWM - 16M colors)
compatible: kinesta,rgb-touchpad-pwm

include: base.yaml

properties:
    "#pwm-cells":
        type: int
        const: 3
    pwms:
        type: phandle-array
        required: true
        description: pwm descriptor for the 3 color leds, in order Red, Green, Blue
    pwm-names:
        type: string-array
    "#gpio-cells":
        type: int
        const: 1
    touch-gpios:
        type: phandle-array
        required: true
        description: gpio descriptor for the touch output
```

## usb_midi/Kconfig
```kconfig
# Copyright (c) 2022 Titouan Christophe
# SPDX-License-Identifier: Apache-2.0

rsource "subsys/usb/device/class/midi/Kconfig"
```

## usb_midi/dts/bindings/usb-midi-jack-in.yaml
```yaml
# Copyright (c) 2022 Titouan Christophe
# SPDX-License-Identifier: Apache-2.0

description: USB-MIDI input jack (data flows into the USB-MIDI subsystem)

compatible: usb-midi-jack-in

include: [base.yaml]

properties:
    reg:
        required: true
        description: Jack ID

    jack-embedded:
        type: boolean
        required: false
```

## usb_midi/dts/bindings/usb-midi-jack-out.yaml
```yaml
# Copyright (c) 2022 Titouan Christophe
# SPDX-License-Identifier: Apache-2.0

description: USB-MIDI output jack (data flows out of the USB-MIDI subsystem)

compatible: usb-midi-jack-out

include: [base.yaml]

properties:
    reg:
        required: true
        description: Jack ID

    jack-embedded:
        type: boolean
        required: false

    input-jacks:
        type: phandles
        required: true
```

## usb_midi/subsys/usb/device/class/midi/Kconfig
```kconfig
# USB MIDI configuration options

# Copyright (c) 2022 Titouan Christophe
# SPDX-License-Identifier: Apache-2.0

config USB_DEVICE_MIDI
	bool "USB MIDI Device Class Driver"
	select RING_BUFFER
	help
	  USB MIDI Device Class driver.
	  Device configuration is done via dt overlay.

if USB_DEVICE_MIDI

config USB_DEVICE_MIDI_NODELABEL_AS_NAME
	bool "Use the devicetree nodelabel as MIDI i/o name"
	default y
	help
	  Each embedded input or output jack in the MIDIStreaming
	  device has an optional string descriptor.
	  Enable this option to set this string to the node label
	  of the usb midi input or output in the device tree

config USB_DEVICE_MIDI_RINGBUF_SIZE
	int "USB MIDI ring buffer size"
	default 128
	help
	  Size of the ring buffers for input/outputs

config USB_DEVICE_MIDI_BULK_EP_SIZE
	int
	default 512 if USB_DC_HAS_HS_SUPPORT
	default 64
	help
	  Max transfer size on bulk USB endpoints

module = USB_MIDI
module-str = USB MIDI
source "subsys/logging/Kconfig.template.log_config"

endif
```

## usb_midi/zephyr/Kconfig
```kconfig
# Copyright (c) 2021 Titouan Christophe
# SPDX-License-Identifier: Apache-2.0

config USB_MIDI
	bool "Enable support for USB MIDI function"
	select RING_BUFFER

choice "USB_MIDI_LOG_LEVEL_CHOICE"
	prompt "Max compiled-in log level for USB MIDI function"
	default USB_MIDI_LOG_LEVEL_INF
	depends on LOG

config USB_MIDI_LOG_LEVEL_OFF
	bool "Off"

config USB_MIDI_LOG_LEVEL_ERR
	bool "Error"

config USB_MIDI_LOG_LEVEL_WRN
	bool "Warning"

config USB_MIDI_LOG_LEVEL_INF
	bool "Info"

config USB_MIDI_LOG_LEVEL_DBG
	bool "Debug"

endchoice

config USB_MIDI_LOG_LEVEL
	int
	depends on LOG
	default 0 if USB_MIDI_LOG_LEVEL_OFF
	default 1 if USB_MIDI_LOG_LEVEL_ERR
	default 2 if USB_MIDI_LOG_LEVEL_WRN
	default 3 if USB_MIDI_LOG_LEVEL_INF
	default 4 if USB_MIDI_LOG_LEVEL_DBG
```
