## CMakeLists.txt
```
# SPDX-License-Identifier: Apache-2.0

set(DTC_OVERLAY_FILE src/kinesta.dts)

list(APPEND ZEPHYR_EXTRA_MODULES ${CMAKE_CURRENT_SOURCE_DIR}/../usb_midi)
list(APPEND ZEPHYR_EXTRA_MODULES ${CMAKE_CURRENT_SOURCE_DIR}/../kinesta_hw)

cmake_minimum_required(VERSION 3.13.1)
find_package(Zephyr REQUIRED HINTS $ENV{ZEPHYR_BASE})

project(kinesta)
FILE(GLOB app_sources src/*.c)
target_sources(app PRIVATE ${app_sources})
```

## prj.conf
```kconfig
# CONFIG_COMPILER_OPT="-Wextra -Werror -Wno-unused-parameter"

CONFIG_LOG=y
CONFIG_LOG_MODE_IMMEDIATE=y
CONFIG_LOG_DEFAULT_LEVEL=3
CONFIG_SOC_LOG_LEVEL_DBG=y
CONFIG_PWM_LOG_LEVEL_DBG=y

CONFIG_SHELL=y

CONFIG_I2C=y
CONFIG_GPIO=y
CONFIG_PWM=y
CONFIG_SENSOR=y
CONFIG_VL53L0X_RECONFIGURE_ADDRESS=y

CONFIG_FPU=y
CONFIG_CBPRINTF_FP_SUPPORT=y

CONFIG_KINESTA_HW=y

CONFIG_USB_DEVICE_STACK=y
CONFIG_USB_DEVICE_MANUFACTURER="iTitou"
CONFIG_USB_DEVICE_PRODUCT="kinesta v2"
CONFIG_USB_DEVICE_MIDI=y
CONFIG_USB_MIDI_LOG_LEVEL_DBG=y
```

## src/main.c
```c
#include <zephyr/kernel.h>
#include <zephyr/usb/usb_device.h>

#include "touchpad.h"
#include "kinesta_functional_block.h"

#include <zephyr/logging/log.h>
LOG_MODULE_REGISTER(app);

void scan_slices_rgb()
{
    color_t colors[] = {COLOR_RED, COLOR_GREEN, COLOR_BLUE};

    for (int i=0; i<N_KFBS; i++){
        LOG_INF("Slice %d", i+1);
        for (int j=0; j<ARRAY_SIZE(colors); j++){
            touchpad_set_color(kfbs[i].primary_touchpad, colors[j]);
            k_sleep(K_MSEC(250));
            touchpad_set_color(kfbs[i].primary_touchpad, 0);

            encoder_set_color(kfbs[i].encoder, colors[j]);
            k_sleep(K_MSEC(250));
            encoder_set_color(kfbs[i].encoder, 0);

            touchpad_set_color(kfbs[i].secondary_touchpad, colors[j]);
            k_sleep(K_MSEC(250));
            touchpad_set_color(kfbs[i].secondary_touchpad, 0);

            if (touchpad_is_touched(kfbs[i].primary_touchpad)){
                touchpad_set_color(kfbs[i].primary_touchpad, COLOR_WHITE);
            }

            if (touchpad_is_touched(kfbs[i].secondary_touchpad)){
                touchpad_set_color(kfbs[i].secondary_touchpad, COLOR_WHITE);
            }

            k_sleep(K_MSEC(250));
            touchpad_set_color(kfbs[i].primary_touchpad, 0);
            touchpad_set_color(kfbs[i].secondary_touchpad, 0);
        }
    }
}

void autotest()
{
    for (int i=0; i<N_KFBS; i++){
        LOG_INF("Initializing KFB %s", kfbs[i].name);
        kfb_init(&kfbs[i]);
    }

    while (true) {
        scan_slices_rgb();
    }
}

/* On the first Kinesta SMD devboard, there is a schematic error where the MIDI
 * UART Tx is wired to PD7 instead of PD5, but only PD5 can be used as UART2_TX.
 * To circumvent the problem, we put a jumper between PD5 and PD7 on the Nucleo,
 * and we set PD7 as input so that it doesn't interfere with the signal sent
 * by PD5
 * 
 *  +---jumper---+
 *  |            |
 * PD7 [NUCLEO] PD5
 *  |
 *  +---kinesta--->MIDI OUT
 */
void setup_wiring_workaround()
{
    const struct device *dev = DEVICE_DT_GET(DT_NODELABEL(gpiod));
    if (! dev){
        LOG_ERR("Unable to open gpiod");
    } else {
        gpio_pin_configure(dev, 7, GPIO_INPUT);
    }
}

void main(void)
{
    // autotest();
    int i;
    kinesta_midi_init();

    // Problems with components on the first slice, so software disable them
    // kfbs[0].soft_disable = true;

    setup_wiring_workaround();

    if (usb_enable(NULL) == 0){
        LOG_INF("USB enabled");
    } else {
        LOG_ERR("Failed to enable USB");
        return;
    }

    LOG_INF("Initializing %d KFB(s)", (int) N_KFBS);

    for (i=0; i<N_KFBS; i++){
        LOG_INF("Initializing KFB %s", kfbs[i].name);
        if (kfb_init(&kfbs[i])){
            return;
        }
    }

    LOG_INF("Starting mainloop");
    while (true){
        for (i=0; i<N_KFBS; i++){
            kfb_update(&kfbs[i]);
        }
        kinesta_midi_update();
        k_sleep(K_MSEC(1));
    }
}
```

## src/approxmath.c
```c
#include <math.h>
#include <stdlib.h>
#include <zephyr/kernel.h>


const float cos256f32[256] = {
    1.0,
    0.9998482259889359,
    0.999392996097145,
    0.9986345866928941,
    0.9975734582035323,
    0.9962102548359679,
    0.994545804185573,
    0.9925811167337533,
    0.9903173852344889,
    0.9877559839902184,
    0.9848984680175048,
    0.9817465721029915,
    0.9783022097502204,
    0.9745674720179507,
    0.9705446262506858,
    0.9662361147021779,
    0.9616445530527447,
    0.9567727288213004,
    0.9516235996730644,
    0.9462002916239739,
    0.9405060971428922,
    0.9345444731527641,
    0.9283190389319314,
    0.9218335739168833,
    0.9150920154077753,
    0.9080984561781109,
    0.9008571419900333,
    0.8933724690167416,
    0.8856489811735904,
    0.8776913673594968,
    0.8695044586103295,
    0.8610932251660046,
    0.8524627734530736,
    0.8436183429846313,
    0.8345653031794291,
    0.825309150102121,
    0.8158555031266255,
    0.806210101524625,
    0.7963788009812774,
    0.7863675700402526,
    0.7761824864802529,
    0.765829733625218,
    0.7553155965904534,
    0.7446464584669619,
    0.7338287964462934,
    0.7228691778882692,
    0.7117742563339622,
    0.7005507674663594,
    0.6892055250211552,
    0.6777454166501591,
    0.6661773997398298,
    0.6545084971874737,
    0.6427457931376711,
    0.6308964286815202,
    0.6189675975213094,
    0.6069665416032488,
    0.5949005467209129,
    0.582776938092065,
    0.5706030759115457,
    0.5583863508829282,
    0.546134179731651,
    0.5338540007023538,
    0.5215532690431479,
    0.5092394524795649,
    0.4969200266809307,
    0.4846024707219149,
    0.472294262542015,
    0.46000287440572923,
    0.44773576836617335,
    0.43550039173489835,
    0.42330417256065733,
    0.4111545151198658,
    0.39905879542149497,
    0.3870243567291262,
    0.37505850510288463,
    0.3631685049639587,
    0.35136157468439866,
    0.3396448822048725,
    0.328025540683036,
    0.31651060417516397,
    0.30510706335366033,
    0.29382184126304833,
    0.28266178911701756,
    0.27163368213907974,
    0.2607442154493568,
    0.2500000000000001,
    0.2394075585617076,
    0.22897332176377527,
    0.21870362419008843,
    0.20860470053341956,
    0.19868268181037185,
    0.1889435916392631,
    0.17939334258321094,
    0.17003773256063864,
    0.16088244132538299,
    0.15193302701853673,
    0.14319492279412388,
    0.13467343352065347,
    0.12637373256055462,
    0.11830085862944861,
    0.11045971273716476,
    0.102855055212357,
    0.09549150281252633,
    0.08837352592120645,
    0.08150544583401115,
    0.074891432135193,
    0.06853550016630516,
    0.06244150858850367,
    0.05661315703996905,
    0.05105398388987098,
    0.04576736409023818,
    0.040756507127038544,
    0.03602445507171265,
    0.0315740807343447,
    0.027408085919590264,
    0.023528999786421756,
    0.019939177312685963,
    0.016640797865406287,
    0.013635863877697663,
    0.010926199633097156,
    0.008513450158049107,
    0.006399080223215503,
    0.004584373454219859,
    0.0030704315523631953,
    0.0018581736257852755,
    0.0009483356314779479,
    0.00034146992848854696,
    3.7944942584688945e-05,
    3.7944942584688945e-05,
    0.00034146992848854696,
    0.0009483356314779479,
    0.00185817362578522,
    0.0030704315523631953,
    0.004584373454219859,
    0.006399080223215503,
    0.008513450158049107,
    0.010926199633097156,
    0.013635863877697607,
    0.016640797865406287,
    0.019939177312685907,
    0.0235289997864217,
    0.027408085919590208,
    0.031574080734344645,
    0.03602445507171259,
    0.04075650712703843,
    0.04576736409023813,
    0.051053983889870924,
    0.056613157039969,
    0.062441508588503614,
    0.06853550016630511,
    0.07489143213519284,
    0.08150544583401109,
    0.08837352592120634,
    0.09549150281252622,
    0.10285505521235688,
    0.1104597127371647,
    0.11830085862944839,
    0.1263737325605545,
    0.13467343352065342,
    0.14319492279412382,
    0.15193302701853661,
    0.16088244132538293,
    0.1700377325606386,
    0.17939334258321082,
    0.18894359163926305,
    0.19868268181037174,
    0.20860470053341945,
    0.21870362419008837,
    0.22897332176377522,
    0.2394075585617073,
    0.24999999999999978,
    0.2607442154493565,
    0.27163368213907946,
    0.2826617891170176,
    0.29382184126304833,
    0.30510706335366033,
    0.31651060417516397,
    0.3280255406830359,
    0.3396448822048723,
    0.35136157468439855,
    0.36316850496395847,
    0.3750585051028844,
    0.38702435672912594,
    0.39905879542149464,
    0.41115451511986545,
    0.423304172560657,
    0.43550039173489846,
    0.44773576836617335,
    0.4600028744057292,
    0.472294262542015,
    0.48460247072191476,
    0.4969200266809306,
    0.5092394524795648,
    0.5215532690431476,
    0.5338540007023536,
    0.5461341797316508,
    0.5583863508829279,
    0.5706030759115455,
    0.5827769380920647,
    0.594900546720913,
    0.6069665416032488,
    0.6189675975213094,
    0.6308964286815202,
    0.642745793137671,
    0.6545084971874736,
    0.6661773997398297,
    0.6777454166501589,
    0.689205525021155,
    0.7005507674663591,
    0.7117742563339619,
    0.7228691778882689,
    0.7338287964462931,
    0.7446464584669619,
    0.7553155965904534,
    0.765829733625218,
    0.7761824864802529,
    0.7863675700402526,
    0.7963788009812773,
    0.8062101015246248,
    0.8158555031266254,
    0.8253091501021209,
    0.8345653031794289,
    0.8436183429846311,
    0.8524627734530734,
    0.8610932251660047,
    0.8695044586103295,
    0.8776913673594968,
    0.8856489811735904,
    0.8933724690167416,
    0.9008571419900333,
    0.9080984561781107,
    0.9150920154077753,
    0.921833573916883,
    0.9283190389319312,
    0.934544473152764,
    0.9405060971428921,
    0.9462002916239738,
    0.9516235996730644,
    0.9567727288213005,
    0.9616445530527447,
    0.9662361147021779,
    0.9705446262506858,
    0.9745674720179506,
    0.9783022097502203,
    0.9817465721029914,
    0.9848984680175047,
    0.9877559839902182,
    0.9903173852344889,
    0.9925811167337533,
    0.9945458041855729,
    0.9962102548359679,
    0.9975734582035323,
    0.9986345866928941,
    0.999392996097145,
    0.9998482259889359,
    1.0
};

float approxcos_normalized(float t)
{
	size_t idx = ARRAY_SIZE(cos256f32) * t;
	return cos256f32[idx % ARRAY_SIZE(cos256f32)];
}


float approxcos(float rad)
{
	return approxcos_normalized(rad / (2 * M_PI));
}
```

## src/approxmath.h
```c
#ifndef ZOIDBERG_APPROXMATH
#define ZOIDBERG_APPROXMATH

float approxcos_normalized(float t);

float approxcos(float rad);

#endif
```

## src/color.c
```c
#include "color.h"

color_t color_map(color_t c1, color_t c2, float t)
{
    if (t < 0){
        t = 0;
    }
    if (t > 1){
        t = 1;
    }

    int gradient_r = color_get_r(c2) - color_get_r(c1);
    int gradient_g = color_get_g(c2) - color_get_g(c1);
    int gradient_b = color_get_b(c2) - color_get_b(c1);

    return color_rgb(
        color_get_r(c1) + t * gradient_r,
        color_get_g(c1) + t * gradient_g,
        color_get_b(c1) + t * gradient_b
    );
}

color_t color_mul(color_t c, float multiplier)
{
    return color_rgb(
        color_get_r(c) * multiplier,
        color_get_g(c) * multiplier,
        color_get_b(c) * multiplier
    );
}
```

## src/color.h
```c
#ifndef COLOR_H
#define COLOR_H

#include <stdint.h>

typedef uint32_t color_t;

#define CLAMP(min, max, value) ((value) < (min)) ? (min) : ((value) > (max)) ? (max) : (value)

#define COLOR_CHAN_BITS 10
#define COLOR_CHAN_HIGHEST_BIT_MASK (1 << (COLOR_CHAN_BITS - 1))
#define COLOR_CHAN_MAX ((1 << COLOR_CHAN_BITS) - 1)

/* Constructors */
static inline color_t color_rgb(unsigned r, unsigned g, unsigned b)
{
    r = CLAMP(0, COLOR_CHAN_MAX, r);
    g = CLAMP(0, COLOR_CHAN_MAX, g);
    b = CLAMP(0, COLOR_CHAN_MAX, b);
    return (r << (2*COLOR_CHAN_BITS)) | (g << COLOR_CHAN_BITS) | b;
}

static inline color_t color_rgbf(float r, float g, float b)
{
    return color_rgb(r*COLOR_CHAN_MAX, g*COLOR_CHAN_MAX, b*COLOR_CHAN_MAX);
}

/* Accessors */
static inline unsigned color_get_r(color_t color)
{
    return (color >> (2*COLOR_CHAN_BITS)) & COLOR_CHAN_MAX;
}

static inline unsigned color_get_g(color_t color)
{
    return (color >> COLOR_CHAN_BITS) & COLOR_CHAN_MAX;
}

static inline unsigned color_get_b(color_t color)
{
    return color & COLOR_CHAN_MAX;
}

static inline void color_get_u8(color_t color, uint8_t *r, uint8_t *g, uint8_t *b)
{
    *r = color_get_r(color) >> (COLOR_CHAN_BITS - 8);
    *g = color_get_g(color) >> (COLOR_CHAN_BITS - 8);
    *b = color_get_b(color) >> (COLOR_CHAN_BITS - 8);
}

/* Predefined palette of colors */
#define COLOR_RED     color_rgbf(1, 0, 0)
#define COLOR_GREEN   color_rgbf(0, 1, 0)
#define COLOR_BLUE    color_rgbf(0, 0, 1)
#define COLOR_YELLOW  color_rgbf(1, 1, 0)
#define COLOR_MAGENTA color_rgbf(1, 0, 1)
#define COLOR_CYAN    color_rgbf(0, 1, 1)
#define COLOR_WHITE   color_rgbf(1, 1, 1)

/**
 * @brief      Map value between 2 colors
 * @param[in]  c1    The first color
 * @param[in]  c2    The second color
 * @param[in]  t     The value to map (must be between 0 and 1)
 * @return     The resulting color
 */
color_t color_map(color_t c1, color_t c2, float t);

/**
 * @brief      Multiply a color by a scalar
 * @param[in]  c           The color
 * @param[in]  multiplier  The scalar multiplier. >1 to ligthen, <1 to darken
 * @return     The scaled color
 */
color_t color_mul(color_t c, float multiplier);

#endif
```

## src/config.h
```c
#ifndef CONFIG_H
#define CONFIG_H

/* Vertical size of the tracking zone above a distance sensor, in cm */
#define DISTANCE_SENSOR_TRACKING_ZONE_CM 55

/* Vertical size of the hysteresis to enter/leave the tracking zone, in cm */
#define DISTANCE_SENSOR_TRACKING_HYSTERESIS_CM 5

/* Alpha coefficient for the exponential moving average used to filter
 * the distance measured by the sensor, as in:
 * DISTANCE[t] = ALPHA*MEASURED_DISTANCE + (1-ALPHA)*DISTANCE[t-1]
 */
#define DISTANCE_SENSOR_FILTERING_ALPHA 1

/* Cable number on the USB-MIDI interface for the MIDI events emitted by
 * the sensors of Kinesta itself */
#define USB_MIDI_SENSORS_JACK_ID 1

#endif
```

## src/cos256f32.c
```c
const float cos256f32[256] = {
    1.0,
    0.9998482259889359,
    0.999392996097145,
    0.9986345866928941,
    0.9975734582035323,
    0.9962102548359679,
    0.994545804185573,
    0.9925811167337533,
    0.9903173852344889,
    0.9877559839902184,
    0.9848984680175048,
    0.9817465721029915,
    0.9783022097502204,
    0.9745674720179507,
    0.9705446262506858,
    0.9662361147021779,
    0.9616445530527447,
    0.9567727288213004,
    0.9516235996730644,
    0.9462002916239739,
    0.9405060971428922,
    0.9345444731527641,
    0.9283190389319314,
    0.9218335739168833,
    0.9150920154077753,
    0.9080984561781109,
    0.9008571419900333,
    0.8933724690167416,
    0.8856489811735904,
    0.8776913673594968,
    0.8695044586103295,
    0.8610932251660046,
    0.8524627734530736,
    0.8436183429846313,
    0.8345653031794291,
    0.825309150102121,
    0.8158555031266255,
    0.806210101524625,
    0.7963788009812774,
    0.7863675700402526,
    0.7761824864802529,
    0.765829733625218,
    0.7553155965904534,
    0.7446464584669619,
    0.7338287964462934,
    0.7228691778882692,
    0.7117742563339622,
    0.7005507674663594,
    0.6892055250211552,
    0.6777454166501591,
    0.6661773997398298,
    0.6545084971874737,
    0.6427457931376711,
    0.6308964286815202,
    0.6189675975213094,
    0.6069665416032488,
    0.5949005467209129,
    0.582776938092065,
    0.5706030759115457,
    0.5583863508829282,
    0.546134179731651,
    0.5338540007023538,
    0.5215532690431479,
    0.5092394524795649,
    0.4969200266809307,
    0.4846024707219149,
    0.472294262542015,
    0.46000287440572923,
    0.44773576836617335,
    0.43550039173489835,
    0.42330417256065733,
    0.4111545151198658,
    0.39905879542149497,
    0.3870243567291262,
    0.37505850510288463,
    0.3631685049639587,
    0.35136157468439866,
    0.3396448822048725,
    0.328025540683036,
    0.31651060417516397,
    0.30510706335366033,
    0.29382184126304833,
    0.28266178911701756,
    0.27163368213907974,
    0.2607442154493568,
    0.2500000000000001,
    0.2394075585617076,
    0.22897332176377527,
    0.21870362419008843,
    0.20860470053341956,
    0.19868268181037185,
    0.1889435916392631,
    0.17939334258321094,
    0.17003773256063864,
    0.16088244132538299,
    0.15193302701853673,
    0.14319492279412388,
    0.13467343352065347,
    0.12637373256055462,
    0.11830085862944861,
    0.11045971273716476,
    0.102855055212357,
    0.09549150281252633,
    0.08837352592120645,
    0.08150544583401115,
    0.074891432135193,
    0.06853550016630516,
    0.06244150858850367,
    0.05661315703996905,
    0.05105398388987098,
    0.04576736409023818,
    0.040756507127038544,
    0.03602445507171265,
    0.0315740807343447,
    0.027408085919590264,
    0.023528999786421756,
    0.019939177312685963,
    0.016640797865406287,
    0.013635863877697663,
    0.010926199633097156,
    0.008513450158049107,
    0.006399080223215503,
    0.004584373454219859,
    0.0030704315523631953,
    0.0018581736257852755,
    0.0009483356314779479,
    0.00034146992848854696,
    3.7944942584688945e-05,
    3.7944942584688945e-05,
    0.00034146992848854696,
    0.0009483356314779479,
    0.00185817362578522,
    0.0030704315523631953,
    0.004584373454219859,
    0.006399080223215503,
    0.008513450158049107,
    0.010926199633097156,
    0.013635863877697607,
    0.016640797865406287,
    0.019939177312685907,
    0.0235289997864217,
    0.027408085919590208,
    0.031574080734344645,
    0.03602445507171259,
    0.04075650712703843,
    0.04576736409023813,
    0.051053983889870924,
    0.056613157039969,
    0.062441508588503614,
    0.06853550016630511,
    0.07489143213519284,
    0.08150544583401109,
    0.08837352592120634,
    0.09549150281252622,
    0.10285505521235688,
    0.1104597127371647,
    0.11830085862944839,
    0.1263737325605545,
    0.13467343352065342,
    0.14319492279412382,
    0.15193302701853661,
    0.16088244132538293,
    0.1700377325606386,
    0.17939334258321082,
    0.18894359163926305,
    0.19868268181037174,
    0.20860470053341945,
    0.21870362419008837,
    0.22897332176377522,
    0.2394075585617073,
    0.24999999999999978,
    0.2607442154493565,
    0.27163368213907946,
    0.2826617891170176,
    0.29382184126304833,
    0.30510706335366033,
    0.31651060417516397,
    0.3280255406830359,
    0.3396448822048723,
    0.35136157468439855,
    0.36316850496395847,
    0.3750585051028844,
    0.38702435672912594,
    0.39905879542149464,
    0.41115451511986545,
    0.423304172560657,
    0.43550039173489846,
    0.44773576836617335,
    0.4600028744057292,
    0.472294262542015,
    0.48460247072191476,
    0.4969200266809306,
    0.5092394524795648,
    0.5215532690431476,
    0.5338540007023536,
    0.5461341797316508,
    0.5583863508829279,
    0.5706030759115455,
    0.5827769380920647,
    0.594900546720913,
    0.6069665416032488,
    0.6189675975213094,
    0.6308964286815202,
    0.642745793137671,
    0.6545084971874736,
    0.6661773997398297,
    0.6777454166501589,
    0.689205525021155,
    0.7005507674663591,
    0.7117742563339619,
    0.7228691778882689,
    0.7338287964462931,
    0.7446464584669619,
    0.7553155965904534,
    0.765829733625218,
    0.7761824864802529,
    0.7863675700402526,
    0.7963788009812773,
    0.8062101015246248,
    0.8158555031266254,
    0.8253091501021209,
    0.8345653031794289,
    0.8436183429846311,
    0.8524627734530734,
    0.8610932251660047,
    0.8695044586103295,
    0.8776913673594968,
    0.8856489811735904,
    0.8933724690167416,
    0.9008571419900333,
    0.9080984561781107,
    0.9150920154077753,
    0.921833573916883,
    0.9283190389319312,
    0.934544473152764,
    0.9405060971428921,
    0.9462002916239738,
    0.9516235996730644,
    0.9567727288213005,
    0.9616445530527447,
    0.9662361147021779,
    0.9705446262506858,
    0.9745674720179506,
    0.9783022097502203,
    0.9817465721029914,
    0.9848984680175047,
    0.9877559839902182,
    0.9903173852344889,
    0.9925811167337533,
    0.9945458041855729,
    0.9962102548359679,
    0.9975734582035323,
    0.9986345866928941,
    0.999392996097145,
    0.9998482259889359,
    1.0
};
```

## src/encoder.c
```c
#include "encoder.h"
#include <drivers/i2c.h>
#include <sys/byteorder.h>

#include "config.h"

#include <logging/log.h>
LOG_MODULE_REGISTER(rgb_encoder);

#define COLOR_CHAN_RSHIFT (COLOR_CHAN_BITS - 8)

#define REG_GCONF    0x00
#define REG_INTCONF  0x04
#define REG_ESTATUS  0x05
#define REG_CVAL0    0x08
#define REG_CVAL1    0x09
#define REG_CVAL2    0x0A
#define REG_CVAL3    0x0B
#define REG_CMAX0    0x0C
#define REG_CMAX1    0x0D
#define REG_CMAX2    0x0E
#define REG_CMAX3    0x0F
#define REG_CMIN0    0x10
#define REG_CMIN1    0x11
#define REG_CMIN2    0x12
#define REG_CMIN3    0x13
#define REG_ISTEP0   0x14
#define REG_ISTEP1   0x15
#define REG_ISTEP2   0x16
#define REG_ISTEP3   0x17
#define REG_RLED     0x18
#define REG_DPPERIOD 0x1F
#define REG_IDCODE   0x70

#define BIT_GCONF_DTYPE (1 << 0)
#define BIT_GCONF_ETYPE (1 << 5)
#define BIT_GCONF_RESET (1 << 7)

/* Same bits defined in ESTATUS and INTCONF */
#define BIT_ESTATUS_PUSHR (1 << 0)
#define BIT_ESTATUS_PUSHP (1 << 1)
#define BIT_ESTATUS_PUSHD (1 << 2)
#define BIT_ESTATUS_IRINC (1 << 3)
#define BIT_ESTATUS_IRDEC (1 << 4)

static inline int encoder_i2c_read(const encoder *enc, uint8_t reg, uint8_t *data, size_t size)
{
    int ret = i2c_burst_read(enc->i2c, enc->addr, reg, data, size);
    if (ret){
        LOG_ERR("[%02X] I2C read of register %02X with size %d failed: %d",
                (int) enc->addr, (int) reg, size, ret);
    }
    return ret;
}

static inline int encoder_i2c_write(const encoder *enc, uint8_t reg, const uint8_t *data, size_t size)
{
    int ret = i2c_burst_write(enc->i2c, enc->addr, reg, data, size);
    if (ret){
        LOG_ERR("[%02X] I2C read of register %02X with size %d failed: %d",
                (int) enc->addr, (int) reg, size, ret);
    }
    return ret;
}

static inline int encoder_i2c_write_byte(const encoder *enc, uint8_t reg, uint8_t data)
{
    return encoder_i2c_write(enc, reg, &data, 1);
}

static inline int encoder_i2c_read_byte(const encoder *enc, uint8_t reg, uint8_t *data)
{
    return encoder_i2c_read(enc, reg, data, 1);
}

static inline int encoder_i2c_write_float(const encoder *enc, uint8_t reg, float data)
{
    uint32_t data_endian = sys_cpu_to_be32(*((uint32_t *) &data));
    return encoder_i2c_write(enc, reg, (const uint8_t *) &data_endian, 4);
}

static inline int encoder_i2c_read_float(const encoder *enc, uint8_t reg, float *data)
{
    uint32_t data_endian;
    uint32_t *data_aliased = (uint32_t *) data;
    int ret = encoder_i2c_read(enc, reg, (uint8_t *) &data_endian, 4);
    if (ret){
        return ret;
    }
    *data_aliased = sys_be32_to_cpu(data_endian);
    return 0;
}

int encoder_init(const encoder *enc)
{
    // 1. Check device ID
    uint8_t idcode[2];
    int ret = encoder_i2c_read(enc, REG_IDCODE, idcode, 2);
    if (ret){
        return ret;
    }
    if (idcode[0] != 0x53 || idcode[1] != 0x23){
        LOG_ERR("Invalid RGB I2C encoder device identifier: %02X, %02X\n",
                (int) idcode[0], (int) idcode[1]);
        return -1;
    }

    // 2. Reset
    ret = encoder_i2c_write_byte(enc, REG_GCONF, BIT_GCONF_RESET);
    if (ret){
        return ret;
    }

    k_sleep(K_MSEC(1));

    // 3. Configure as RGB illuminated encoder in float32
    ret = encoder_i2c_write_byte(enc, REG_GCONF, BIT_GCONF_ETYPE | BIT_GCONF_DTYPE);
    if (ret){
        return ret;
    }

    // 4. Set encoder range
    ret = encoder_i2c_write_float(enc, REG_CMAX0, 1.0f);
    if (ret){
        return ret;
    }
    ret = encoder_i2c_write_float(enc, REG_CMIN0, 0.0f);
    if (ret){
        return ret;
    }
    ret = encoder_i2c_write_float(enc, REG_ISTEP0, 1.0f / ENCODER_N_STEPS);
    if (ret){
        return ret;
    }

    // 5. Configure events (click and double-click)
    ret = encoder_i2c_write_byte(enc, REG_INTCONF, BIT_ESTATUS_PUSHP | BIT_ESTATUS_PUSHR | BIT_ESTATUS_PUSHD | BIT_ESTATUS_IRINC | BIT_ESTATUS_IRDEC);
    if (ret){
        return ret;
    }
    /*
    ret = encoder_i2c_write_byte(enc, REG_DPPERIOD, 25); // 250ms
    if (ret){
        return ret;
    }
    */

    return 0;
}

int encoder_set_color(const encoder *enc, color_t color)
{
    uint8_t rgb_value[3];
    color_get_u8(color, &rgb_value[0], &rgb_value[1], &rgb_value[2]);
    return encoder_i2c_write(enc, REG_RLED, rgb_value, 3);
}

int encoder_get_value(const encoder *enc, float *value)
{
    return encoder_i2c_read_float(enc, REG_CVAL0, value);
}

int encoder_set_value(const encoder *enc, float value)
{
    return encoder_i2c_write_float(enc, REG_CVAL0, value);
}

int encoder_get_event(const encoder *enc, int *evt)
{
    int evt_value = 0;
    uint8_t estatus;
    int ret = encoder_i2c_read_byte(enc, REG_ESTATUS, &estatus);
    if (ret){
        return ret;
    }

    if (estatus & BIT_ESTATUS_PUSHD){
        evt_value |= ENCODER_EVT_DOUBLE_CLICK;
    }
    if (estatus & BIT_ESTATUS_PUSHR){
        evt_value |= ENCODER_EVT_RELEASE;
    }
    if (estatus & BIT_ESTATUS_PUSHP){
        evt_value |= ENCODER_EVT_PRESS;
    }
    *evt = evt_value;
    return 0;
}
```

## src/encoder.h
```c
#ifndef ENCODER_H
#define ENCODER_H

#include <zephyr.h>
#include "color.h"

#define ENCODER_DT_SPEC(name) {\
    .i2c=DEVICE_DT_GET(DT_BUS(DT_NODELABEL(name))),\
    .addr=DT_REG_ADDR(DT_NODELABEL(name))\
}

#define ENCODER_EVT_PRESS        (1 << 0)
#define ENCODER_EVT_RELEASE      (1 << 1)
#define ENCODER_EVT_DOUBLE_CLICK (1 << 2)

typedef struct {
    const struct device *i2c;
    uint8_t addr;
} encoder;

int encoder_init(const encoder *enc);

int encoder_set_color(const encoder *enc, color_t color);

int encoder_get_value(const encoder *enc, float *value);

int encoder_set_value(const encoder *enc, float value);

int encoder_get_event(const encoder *enc, int *evt);

#endif
```

## src/kinesta_functional_block.c
```c
#include "kinesta_functional_block.h"
#include "config.h"
#include "usb_midi.h"
#include "kinesta_midi.h"
#include "lookup.h"

#include <zephyr/kernel.h>
#include <zephyr/device.h>
#include <zephyr/devicetree.h>
#include <zephyr/drivers/sensor.h>

#include <zephyr/logging/log.h>
LOG_MODULE_REGISTER(kfb);

#define TOF_SAMPLING_FREQ 25

#define KFB_FROM_DT(inst) \
    {\
        .name=DT_NODE_FULL_NAME(inst),\
        .midi_cc_group=DT_PROP(inst, midi_cc_group),\
        .tof=DEVICE_DT_GET(DT_PROP(inst, distance_sensor)),\
        .primary_touchpad=DEVICE_DT_GET(DT_PROP(inst, primary_touchpad)),\
        .secondary_touchpad=DEVICE_DT_GET(DT_PROP(inst, secondary_touchpad)),\
        .encoder=DEVICE_DT_GET(DT_PROP(inst, encoder)),\
    },

static kinesta_functional_block __kfbs__[] = {
    DT_FOREACH_STATUS_OKAY(kinesta_functional_block, KFB_FROM_DT)
};

const size_t N_KFBS = ARRAY_SIZE(__kfbs__);

kinesta_functional_block *kfbs = __kfbs__;

#define WHITE_FOR_TOUCH color_rgbf(0.93, 1.0, 0.93)

static int kfb_measure_distance_cm(kinesta_functional_block *self, double *res)
{
    int r = sensor_sample_fetch(self->tof);
    if (r){
        return r;
    }
    
    struct sensor_value distance_value;
    r = sensor_channel_get(self->tof, SENSOR_CHAN_DISTANCE, &distance_value);
    if (r){
        return r;
    }
    
    *res = 100 * sensor_value_to_double(&distance_value);
    return 0;
}

/* Distance remapped on 0..1
 *   Below 0 is above the tracking zone
 *   0 is the highest position in the tracking zone
 *   1 is the lowest position
 */
static inline double kfb_get_distance_t(kinesta_functional_block *self)
{
    return 1 - (self->filtered_distance_cm / DISTANCE_SENSOR_TRACKING_ZONE_CM);
}

static int kfb_update_distance(kinesta_functional_block *self)
{
    double measured_distance_cm;
    int r = kfb_measure_distance_cm(self, &measured_distance_cm);
    if (r){
        return r;
    }

    // This is definitely a reading error !
    if (measured_distance_cm < 1){
        return;
    }

    if (self->is_in_tracking_zone){
        self->filtered_distance_cm = (
            DISTANCE_SENSOR_FILTERING_ALPHA * measured_distance_cm +
            (1 - DISTANCE_SENSOR_FILTERING_ALPHA) * self->filtered_distance_cm
        );
    } else {
        self->filtered_distance_cm = measured_distance_cm;
    }

    // Hysteresis on enter/exit tracking zone
    double threshold = self->is_in_tracking_zone ?
        DISTANCE_SENSOR_TRACKING_ZONE_CM :
        DISTANCE_SENSOR_TRACKING_ZONE_CM - DISTANCE_SENSOR_TRACKING_HYSTERESIS_CM;
    self->is_in_tracking_zone = self->filtered_distance_cm < threshold;

    double t = kfb_get_distance_t(self);
    uint8_t distance_midi_cc_value = (t < 0) ? 0 : (127 * t);
    if (distance_midi_cc_value != self->distance_midi_cc_value && ! self->is_frozen){
        const uint8_t pkt[] = MIDI_CONTROL_CHANGE(0, self->midi_cc_group | 1, distance_midi_cc_value);
        kinesta_midi_out(pkt);
        self->distance_midi_cc_value = distance_midi_cc_value;
    }
    return 0;
}

static int kfb_update_primary_touchpad(kinesta_functional_block *self)
{
    int64_t now = k_uptime_get();
    self->was_primary_pad_touched = self->is_primary_pad_touched;
    self->is_primary_pad_touched = touchpad_is_touched(self->primary_touchpad) > 0;

    // Update touchpad color
    color_t color;
    if (self->is_primary_pad_touched){
        // Pad touched: white
        color = WHITE_FOR_TOUCH;
        if (! self->was_primary_pad_touched){
            self->is_frozen = ! self->is_frozen;
        }
    } else if (self->is_frozen) {
        // Frozen to a MIDI value: blink in the color map
        float t = (float) self->distance_midi_cc_value / 127;
        color = color_map(COLOR_GREEN, COLOR_RED, t);
        color = color_mul(color, cos256f32[(now >> 1) & 0xff]);
    } else if (self->is_in_tracking_zone){
        // In tracking zone: colormap green to red
        color = color_map(COLOR_GREEN, COLOR_RED, kfb_get_distance_t(self));
    } else if (self->filtered_distance_cm < 3 * DISTANCE_SENSOR_TRACKING_ZONE_CM) {
        // Above the sensor but out of tracking zone: blue
        color = COLOR_BLUE;
    } else if (usb_midi_is_configured()) {
        // Otherwise: light cyan if USB is configured
        color = color_mul(COLOR_CYAN, 0.05);
    } else {
        // Otherwise: light magenta if USB not configured
        color = color_mul(COLOR_MAGENTA, 0.05);
    }
    touchpad_set_color(self->primary_touchpad, color);
    return 0;
}

static int kfb_update_secondary_touchpad(kinesta_functional_block *self)
{
    self->was_secondary_pad_touched = self->is_secondary_pad_touched;
    self->is_secondary_pad_touched = touchpad_is_touched(self->secondary_touchpad);
    if (self->was_secondary_pad_touched != self->is_secondary_pad_touched) {
        const uint8_t pkt[] = MIDI_CONTROL_CHANGE(0, self->midi_cc_group | 2, 127 * self->is_secondary_pad_touched);
        kinesta_midi_out(pkt);
    }

    color_t color = self->is_secondary_pad_touched ? WHITE_FOR_TOUCH : 0;
    touchpad_set_color(self->secondary_touchpad, color);
    return 0;
}

static int kfb_update_encoder(kinesta_functional_block *self, int evt)
{
    int r;
    if (evt & ENCODER_EVT_PRESS){
        // Click on the encoder: reset value
        r = encoder_get_value(self->encoder, &self->encoder_value);
        if (r){
            return r;
        }
        // If the actual encoder value is 0: set to 1, otherwise set to 0
        self->encoder_value = (self->encoder_value == 0) ? 1 : 0;
        r = encoder_set_value(self->encoder, self->encoder_value);
        if (r){
            return r;
        }
    } else {
        // Otherwise get actual value
        r = encoder_get_value(self->encoder, &self->encoder_value);
        if (r){
            return r;
        }
    }

    uint8_t encoder_midi_cc_value = 127 * self->encoder_value;
    if (encoder_midi_cc_value != self->encoder_midi_cc_value){
        const uint8_t pkt[] = MIDI_CONTROL_CHANGE(0, self->midi_cc_group | 3, encoder_midi_cc_value);
        kinesta_midi_out(pkt);
        self->encoder_midi_cc_value = encoder_midi_cc_value;
    }
    color_t color = color_map(COLOR_GREEN, COLOR_RED, self->encoder_value);
    return encoder_set_color(self->encoder, color);
}

static void kfb_encoder_changed(struct encoder_callback_t *callback, int event)
{
    kinesta_functional_block *self = CONTAINER_OF(callback, kinesta_functional_block, encoder_change);
    kfb_update_encoder(self, event);
}

static void kfb_tof_data_ready(const struct device *tof, const struct sensor_trigger *trig)
{
    for (size_t i=0; i<N_KFBS; i++){
        if (tof == kfbs[i].tof){
            kfb_update_distance(&kfbs[i]);
            return;
        }
    }
}

int kfb_init(kinesta_functional_block *self)
{
    int r;
    touchpad_set_color(self->primary_touchpad, 0);
    touchpad_set_color(self->secondary_touchpad, 0);

    if (! device_is_ready(self->encoder)){
        LOG_ERR("[%s] encoder is not ready", self->name);
        return -1;
    }

    if (encoder_set_color(self->encoder, 0)){
        LOG_ERR("[%s] Unable to light off the encoder", self->name);
    }

    if (! device_is_ready(self->tof)){
        LOG_ERR("[%s] ToF sensor is not ready", self->name);
        return -1;
    }

    const struct sensor_value freq = {.val1=TOF_SAMPLING_FREQ, .val2=0};
    r = sensor_attr_set(self->tof, SENSOR_CHAN_DISTANCE, SENSOR_ATTR_SAMPLING_FREQUENCY, &freq);
    if (r){
        LOG_ERR("[%s] Unable to configure ToF sampling freq to %dHz", self->name, TOF_SAMPLING_FREQ);
        return r;
    }

    const struct sensor_trigger trig = {
        .chan = SENSOR_CHAN_DISTANCE,
        .type = SENSOR_TRIG_DATA_READY,
    };
    r = sensor_trigger_set(self->tof, &trig, kfb_tof_data_ready);
    if (r == 0){
        self->trigger_enabled = true;
    } else if (r != -ENOTSUP){
        LOG_ERR("[%s] Unable to set ToF trigger", self->name);
        return r;
    }

    self->encoder_change.func = kfb_encoder_changed;
    encoder_set_callback(self->encoder, &self->encoder_change);

    r = kfb_update_encoder(self, 0);
    if (r){
        return r;
    }

    return kfb_update(self);
}

int kfb_update(kinesta_functional_block *self)
{
    if (self->soft_disable){
        touchpad_set_color(self->primary_touchpad, 0);
        touchpad_set_color(self->secondary_touchpad, 0);
        encoder_set_color(self->encoder, 0);
        return 0;
    }

    if (! self->trigger_enabled){
        kfb_update_distance(self);
    }

    int r = kfb_update_primary_touchpad(self);
    if (r){
        return r;
    }

    return kfb_update_secondary_touchpad(self);
}
```

## src/kinesta_functional_block.h
```c
#ifndef KINESTA_FUNCTIONAL_BLOCK_H
#define KINESTA_FUNCTIONAL_BLOCK_H

#include "encoder.h"
#include "touchpad.h"

typedef struct {
    bool soft_disable;

    bool trigger_enabled;

    const char *name;
    const uint8_t midi_cc_group;
    const struct device *tof;
    const struct device *primary_touchpad;
    const struct device *secondary_touchpad;
    const struct device *encoder;

    // Events
    struct encoder_callback_t encoder_change;

    // Sensor input values
    double filtered_distance_cm;
    float encoder_value;
    bool is_in_tracking_zone;
    bool is_primary_pad_touched;
    bool was_primary_pad_touched;
    bool is_secondary_pad_touched;
    bool was_secondary_pad_touched;

    // MIDI-CC values
    uint8_t distance_midi_cc_value;
    uint8_t encoder_midi_cc_value;

    // Software functions
    bool is_frozen;
} kinesta_functional_block;

extern const size_t N_KFBS;
extern kinesta_functional_block *kfbs;

int kfb_init(kinesta_functional_block *self);

int kfb_update(kinesta_functional_block *self);

#endif
```

## src/kinesta_midi.c
```c
#include "kinesta_midi.h"
#include "config.h"
#include "usb_midi.h"

#include <zephyr/drivers/uart.h>
#include <zephyr/drivers/gpio.h>

struct kinesta_midi_din {
    bool enabled;
    const struct device *uart;
    const struct gpio_dt_spec rx_led;
    const struct gpio_dt_spec tx_led;
};

#define KMIDI_FROM_DT(node) \
    {.enabled=true, .uart=DEVICE_DT_GET(DT_PROP(node, uart)), \
     .rx_led=GPIO_DT_SPEC_GET(node, rx_led_gpios), \
     .tx_led=GPIO_DT_SPEC_GET(node, tx_led_gpios)},

#define N_MIDI_DINS ARRAY_SIZE(midi_dins)

static struct kinesta_midi_din midi_dins[] = {
    DT_FOREACH_STATUS_OKAY(kinesta_midi_din, KMIDI_FROM_DT)
};

static void kinesta_midi_din_transmit(struct kinesta_midi_din *self, const uint8_t midi_pkt[3]) {
    if (! self->enabled){
        gpio_pin_set_dt(&self->tx_led, 0);
        gpio_pin_set_dt(&self->rx_led, 0);
        return;
    }

    gpio_pin_set_dt(&self->tx_led, 1);

    uint8_t midi_cmd = midi_pkt[0] >> 4;
    for (size_t i=0; i<midi_datasize(midi_cmd); i++){
        uart_poll_out(self->uart, midi_pkt[i]);
    }

    gpio_pin_set_dt(&self->tx_led, 0);
}

static bool kinesta_midi_usb_enabled = true;

void kinesta_midi_out(const uint8_t midi_pkt[3])
{
    #warning PATCH For defective secondary pad on slice 3 active !
    // Secondary pad of the 3rd slice is broken, let's ignore midi transmission for now
    if (midi_pkt[0] == 0xb0 && midi_pkt[1] == 0x32){
        return;
    }
    for (size_t i=0; i<N_MIDI_DINS; i++){
        kinesta_midi_din_transmit(&midi_dins[i], midi_pkt);
    }

    if (kinesta_midi_usb_enabled) {
        usb_midi_write(USB_MIDI_SENSORS_JACK_ID, midi_pkt);
    }
}

static bool din_btn_was_pressed = false;
static bool usb_btn_was_pressed = false;
static const struct gpio_dt_spec din_btn_pressed = GPIO_DT_SPEC_GET(DT_NODELABEL(midi_din_btn_pressed), gpios);
static const struct gpio_dt_spec usb_btn_pressed = GPIO_DT_SPEC_GET(DT_NODELABEL(midi_usb_btn_pressed), gpios);
static const struct gpio_dt_spec din_btn_led = GPIO_DT_SPEC_GET(DT_NODELABEL(midi_din_btn_led), gpios);
static const struct gpio_dt_spec usb_btn_led = GPIO_DT_SPEC_GET(DT_NODELABEL(midi_usb_btn_led), gpios);

void kinesta_midi_init()
{

	gpio_pin_configure_dt(&din_btn_pressed, GPIO_INPUT);
	gpio_pin_configure_dt(&usb_btn_pressed, GPIO_INPUT);
	gpio_pin_configure_dt(&din_btn_led, GPIO_OUTPUT);
	gpio_pin_configure_dt(&usb_btn_led, GPIO_OUTPUT);

	if (N_MIDI_DINS){
		gpio_pin_set_dt(&din_btn_led, midi_dins[0].enabled);
	}
	gpio_pin_set_dt(&usb_btn_led, kinesta_midi_usb_enabled);

    for (size_t i=0; i<N_MIDI_DINS; i++){
        gpio_pin_configure_dt(&midi_dins[i].tx_led, GPIO_OUTPUT);
        gpio_pin_configure_dt(&midi_dins[i].rx_led, GPIO_OUTPUT);
    }
}

void kinesta_midi_update()
{
	if (N_MIDI_DINS){
		bool din_btn_is_pressed = gpio_pin_get_dt(&din_btn_pressed);
		if (din_btn_was_pressed && ! din_btn_is_pressed){
			midi_dins[0].enabled = !midi_dins[0].enabled;
			gpio_pin_set_dt(&din_btn_led, midi_dins[0].enabled);
		}
		din_btn_was_pressed = din_btn_is_pressed;
	}

	bool usb_btn_is_pressed = gpio_pin_get_dt(&usb_btn_pressed);
	if (usb_btn_was_pressed && ! usb_btn_is_pressed){
		kinesta_midi_usb_enabled = !kinesta_midi_usb_enabled;
		gpio_pin_set_dt(&usb_btn_led, kinesta_midi_usb_enabled);
	}
	usb_btn_was_pressed = usb_btn_is_pressed;
}
```

## src/kinesta_midi.h
```c
#ifndef KINESTA_MIDI_H
#define KINESTA_MIDI_H

#include <stdint.h>

void kinesta_midi_out(const uint8_t pkt[3]);

float kinesta_midi_get_beat();

#endif
```
