## CMakeLists.txt
```
# SPDX-License-Identifier: Apache-2.0

set(DTC_OVERLAY_FILE src/usb-midi.dts)

list(APPEND ZEPHYR_EXTRA_MODULES ${CMAKE_CURRENT_SOURCE_DIR}/../usb_midi)
list(APPEND ZEPHYR_EXTRA_MODULES ${CMAKE_CURRENT_SOURCE_DIR}/../kinesta_hw)

cmake_minimum_required(VERSION 3.20)
find_package(Zephyr REQUIRED HINTS $ENV{ZEPHYR_BASE})
project(midizephyr)

target_sources(app PRIVATE src/main.c src/strerrno.c src/approxmath.c)
```

## prj.conf
```kconfig
CONFIG_GPIO=y

CONFIG_LOG=y
CONFIG_LOG_MODE_IMMEDIATE=y

CONFIG_USB_DEVICE_STACK=y
CONFIG_USB_DEVICE_MANUFACTURER="iTitou"
CONFIG_USB_DEVICE_PRODUCT="midizephyr"

CONFIG_KINESTA_HW=y

CONFIG_USB_DEVICE_MIDI=y
# CONFIG_USB_MIDI_LOG_LEVEL_DBG=y
```

## src/main.c
```c
#include <math.h>
#include <stdio.h>

#include <zephyr/drivers/gpio.h>
#include <zephyr/kernel.h>
#include <zephyr/logging/log.h>
#include <zephyr/usb/usb_device.h>
#include <usb_midi.h>

#include "encoder.h"

#include "strerrno.h"
#include "approxmath.h"

LOG_MODULE_REGISTER(main, LOG_LEVEL_INF);

#define FORWARD_TO_MIDI_PORT midi_in

// static const struct device *encoder = DEVICE_DT_GET(DT_NODELABEL(encoder1));
static const struct device *const midi_in = DEVICE_DT_GET(DT_NODELABEL(midi_in));
static const struct device *const midi_out = DEVICE_DT_GET(DT_NODELABEL(midi_out));
static const struct device *const midi_in2 = DEVICE_DT_GET(DT_NODELABEL(midi_in2));
static const struct device *const midi_out2 = DEVICE_DT_GET(DT_NODELABEL(midi_out2));
static const struct gpio_dt_spec led = GPIO_DT_SPEC_GET(DT_ALIAS(led1), gpios);


static const struct device *midi_ports[] = {midi_in, midi_out, midi_in2, midi_out2};

void main()
{
	gpio_pin_configure_dt(&led, GPIO_OUTPUT);
	gpio_pin_set_dt(&led, 0);

	for (size_t i=0; i<ARRAY_SIZE(midi_ports); i++){
		if (! device_is_ready(midi_ports[i])) {
			LOG_ERR("Device is not ready: %s", midi_ports[i]->name);
		}
	}

	int ret = usb_enable(NULL);
	if (ret != 0) {
		LOG_ERR("Failed to enable USB");
		return;
	}

	LOG_INF("USB enabled");

	const uint8_t *data;
	while (1){
		int r = usb_midi_peak(midi_out, &data, 10);
		if (r < 0){
			LOG_ERR("usb_midi_peak() -> %d", r);
			continue;
		}

		if (r > 0){
			for (int i=0; i<r; i++){
				printf("%02hhX ", data[i]);
			}
			printf("\n");
		}

		usb_midi_read_continue(midi_out, r);
	}
}
```

## src/approxmath.c
```c
../../kinesta/src/approxmath.c
```

## src/approxmath.h
```c
../../kinesta/src/approxmath.h
```

## src/strerrno.c
```c
#include "errno.h"

const char *strerrno(int err)
{
	if (err < 0){
		err = -err;
	}
	switch (err){
	case EPERM: return "EPERM";
	case ENOENT: return "ENOENT";
	case ESRCH: return "ESRCH";
	case EINTR: return "EINTR";
	case EIO: return "EIO";
	case ENXIO: return "ENXIO";
	case E2BIG: return "E2BIG";
	case ENOEXEC: return "ENOEXEC";
	case EBADF: return "EBADF";
	case ECHILD: return "ECHILD";
	case EAGAIN: return "EAGAIN";
	case ENOMEM: return "ENOMEM";
	case EACCES: return "EACCES";
	case EFAULT: return "EFAULT";
	case ENOTBLK: return "ENOTBLK";
	case EBUSY: return "EBUSY";
	case EEXIST: return "EEXIST";
	case EXDEV: return "EXDEV";
	case ENODEV: return "ENODEV";
	case ENOTDIR: return "ENOTDIR";
	case EISDIR: return "EISDIR";
	case EINVAL: return "EINVAL";
	case ENFILE: return "ENFILE";
	case EMFILE: return "EMFILE";
	case ENOTTY: return "ENOTTY";
	case ETXTBSY: return "ETXTBSY";
	case EFBIG: return "EFBIG";
	case ENOSPC: return "ENOSPC";
	case ESPIPE: return "ESPIPE";
	case EROFS: return "EROFS";
	case EMLINK: return "EMLINK";
	case EPIPE: return "EPIPE";
	case EDOM: return "EDOM";
	case ERANGE: return "ERANGE";
	case ENOMSG: return "ENOMSG";
	case EDEADLK: return "EDEADLK";
	case ENOLCK: return "ENOLCK";
	case ENOSTR: return "ENOSTR";
	case ENODATA: return "ENODATA";
	case ETIME: return "ETIME";
	case ENOSR: return "ENOSR";
	case EPROTO: return "EPROTO";
	case EBADMSG: return "EBADMSG";
	case ENOSYS: return "ENOSYS";
	case ENOTEMPTY: return "ENOTEMPTY";
	case ENAMETOOLONG: return "ENAMETOOLONG";
	case ELOOP: return "ELOOP";
	case EOPNOTSUPP: return "EOPNOTSUPP";
	case EPFNOSUPPORT: return "EPFNOSUPPORT";
	case ECONNRESET: return "ECONNRESET";
	case ENOBUFS: return "ENOBUFS";
	case EAFNOSUPPORT: return "EAFNOSUPPORT";
	case EPROTOTYPE: return "EPROTOTYPE";
	case ENOTSOCK: return "ENOTSOCK";
	case ENOPROTOOPT: return "ENOPROTOOPT";
	case ESHUTDOWN: return "ESHUTDOWN";
	case ECONNREFUSED: return "ECONNREFUSED";
	case EADDRINUSE: return "EADDRINUSE";
	case ECONNABORTED: return "ECONNABORTED";
	case ENETUNREACH: return "ENETUNREACH";
	case ENETDOWN: return "ENETDOWN";
	case ETIMEDOUT: return "ETIMEDOUT";
	case EHOSTDOWN: return "EHOSTDOWN";
	case EHOSTUNREACH: return "EHOSTUNREACH";
	case EINPROGRESS: return "EINPROGRESS";
	case EALREADY: return "EALREADY";
	case EDESTADDRREQ: return "EDESTADDRREQ";
	case EMSGSIZE: return "EMSGSIZE";
	case EPROTONOSUPPORT: return "EPROTONOSUPPORT";
	case ESOCKTNOSUPPORT: return "ESOCKTNOSUPPORT";
	case EADDRNOTAVAIL: return "EADDRNOTAVAIL";
	case ENETRESET: return "ENETRESET";
	case EISCONN: return "EISCONN";
	case ENOTCONN: return "ENOTCONN";
	case ETOOMANYREFS: return "ETOOMANYREFS";
	case ENOTSUP: return "ENOTSUP";
	case EILSEQ: return "EILSEQ";
	case EOVERFLOW: return "EOVERFLOW";
	case ECANCELED: return "ECANCELED";
	}
}
```

## src/strerrno.h
```c
#ifndef ZOIDBERG_STRERRNO
#define ZOIDBERG_STRERRNO

const char *strerrno(int err);

#endif
```

## src/usb_midi.c
```c
/**
 * See https://www.usb.org/document-library/usb-midi-devices-10
 */

#include <kernel.h>
#include <sys/byteorder.h>
#include <sys/ring_buffer.h>
#include <usb/usb_common.h>
#include <usb/usb_device.h>

#include "usb_midi.h"

#include <logging/log.h>
LOG_MODULE_REGISTER(usb_midi);

/*             
MIDI sockets   USB-MIDI function                USB function   
------------   -----------------                ------------

               ---------------------------
               |                         |
               *   EMB_OUT_INT_MIDI_IN >-*--+ 0
               |                         |  +---> MIDI_IN_ENDPOINT
EXT_MIDI_IN  >-*-> EMB_OUT_EXT_MIDI_IN >-*--+ 1
               |                         |
EXT_MIDI_OUT <-*-< EMB_IN_EXT_MIDI_OUT <-*------< MIDI_OUT_ENDPOINT
               |                         |
               ---------------------------
 */


#define EXTERNAL_MIDI_IN_ID  1
#define EXTERNAL_MIDI_OUT_ID 2
#define EMBEDDED_OUT_INTERNAL_MIDI_IN_ID 3
#define EMBEDDED_OUT_EXTERNAL_MIDI_IN_ID 4
#define EMBEDDED_IN_EXTERNAL_MIDI_OUT_ID 5
#define MIDI_IN_ENDPOINT_ID  0x81
#define MIDI_OUT_ENDPOINT_ID 0x01

#define EXTERNAL_MIDI_IN_NAME "MIDI IN socket"
#define EXTERNAL_MIDI_OUT_NAME "MIDI OUT socket"
#define EMBEDDED_OUT_INTERNAL_MIDI_IN_NAME "Int. MIDI IN (sensors)"
#define EMBEDDED_OUT_EXTERNAL_MIDI_IN_NAME "Ext. MIDI IN"
#define EMBEDDED_IN_EXTERNAL_MIDI_OUT_NAME "Ext. MIDI OUT"

static struct usb_ep_cfg_data ep_cfg[] = {
    {.ep_cb=usb_transfer_ep_callback, .ep_addr=MIDI_IN_ENDPOINT_ID},
    {.ep_cb=usb_transfer_ep_callback, .ep_addr=MIDI_OUT_ENDPOINT_ID},
};

/*
 * The USB Unicode bString is encoded in UTF16LE, which means it takes up
 * twice the amount of bytes than the same string encoded in ASCII7.
 * Use this macro to determine the length of the bString array.
 *
 * bString length without null character:
 *   bString_length = (sizeof(initializer_string) - 1) * 2
 * or:
 *   bString_length = sizeof(initializer_string) * 2 - 2
 */
#define USB_BSTRING_LENGTH(s)       (sizeof(s) * 2 - 2)

/*
 * The length of the string descriptor (bLength) is calculated from the
 * size of the two octets bLength and bDescriptorType plus the
 * length of the UTF16LE string:
 *
 *   bLength = 2 + bString_length
 *   bLength = 2 + sizeof(initializer_string) * 2 - 2
 *   bLength = sizeof(initializer_string) * 2
 * Use this macro to determine the bLength of the string descriptor.
 */
#define USB_STRING_DESCRIPTOR_LENGTH(s) (sizeof(s) * 2)

struct usb_string_desription {
    struct usb_string_descriptor lang_descr;
    struct {
        uint8_t bLength;
        uint8_t bDescriptorType;
        uint8_t bString[USB_BSTRING_LENGTH(CONFIG_USB_DEVICE_MANUFACTURER)];
    } __packed utf16le_mfr;

    struct {
        uint8_t bLength;
        uint8_t bDescriptorType;
        uint8_t bString[USB_BSTRING_LENGTH(CONFIG_USB_DEVICE_PRODUCT)];
    } __packed utf16le_product;

    struct {
        uint8_t bLength;
        uint8_t bDescriptorType;
        uint8_t bString[USB_BSTRING_LENGTH(CONFIG_USB_DEVICE_SN)];
    } __packed utf16le_sn;

    struct {
        uint8_t bLength;
        uint8_t bDescriptorType;
        uint8_t bString[USB_BSTRING_LENGTH(EXTERNAL_MIDI_IN_NAME)];
    } __packed utf16le_EXTERNAL_MIDI_IN;
    struct {
        uint8_t bLength;
        uint8_t bDescriptorType;
        uint8_t bString[USB_BSTRING_LENGTH(EXTERNAL_MIDI_OUT_NAME)];
    } __packed utf16le_EXTERNAL_MIDI_OUT;
    struct {
        uint8_t bLength;
        uint8_t bDescriptorType;
        uint8_t bString[USB_BSTRING_LENGTH(EMBEDDED_OUT_INTERNAL_MIDI_IN_NAME)];
    } __packed utf16le_EMBEDDED_OUT_INTERNAL_MIDI_IN;
    struct {
        uint8_t bLength;
        uint8_t bDescriptorType;
        uint8_t bString[USB_BSTRING_LENGTH(EMBEDDED_OUT_EXTERNAL_MIDI_IN_NAME)];
    } __packed utf16le_EMBEDDED_OUT_EXTERNAL_MIDI_IN;
    struct {
        uint8_t bLength;
        uint8_t bDescriptorType;
        uint8_t bString[USB_BSTRING_LENGTH(EMBEDDED_IN_EXTERNAL_MIDI_OUT_NAME)];
    } __packed utf16le_EMBEDDED_IN_EXTERNAL_MIDI_OUT;
} __packed;


USBD_STRING_DESCR_DEFINE(primary)
struct usb_string_desription string_descr = {
    .lang_descr = {
        .bLength = sizeof(struct usb_string_descriptor),
        .bDescriptorType = USB_STRING_DESC,
        .bString = sys_cpu_to_le16(0x0409),
    },
    
    .utf16le_mfr = {
        .bLength = USB_STRING_DESCRIPTOR_LENGTH(CONFIG_USB_DEVICE_MANUFACTURER),
        .bDescriptorType = USB_STRING_DESC,
        .bString = CONFIG_USB_DEVICE_MANUFACTURER,
    },
    .utf16le_product = {
        .bLength = USB_STRING_DESCRIPTOR_LENGTH(CONFIG_USB_DEVICE_PRODUCT),
        .bDescriptorType = USB_STRING_DESC,
        .bString = CONFIG_USB_DEVICE_PRODUCT,
    },
    .utf16le_sn = {
        .bLength = USB_STRING_DESCRIPTOR_LENGTH(CONFIG_USB_DEVICE_SN),
        .bDescriptorType = USB_STRING_DESC,
        .bString = CONFIG_USB_DEVICE_SN,
    },

    .utf16le_EXTERNAL_MIDI_IN = {
        .bLength = USB_STRING_DESCRIPTOR_LENGTH(EXTERNAL_MIDI_IN_NAME),
        .bDescriptorType = USB_STRING_DESC,
        .bString = EXTERNAL_MIDI_IN_NAME,
    },
    .utf16le_EXTERNAL_MIDI_OUT = {
        .bLength = USB_STRING_DESCRIPTOR_LENGTH(EXTERNAL_MIDI_OUT_NAME),
        .bDescriptorType = USB_STRING_DESC,
        .bString = EXTERNAL_MIDI_OUT_NAME,
    },
    .utf16le_EMBEDDED_OUT_INTERNAL_MIDI_IN = {
        .bLength = USB_STRING_DESCRIPTOR_LENGTH(EMBEDDED_OUT_INTERNAL_MIDI_IN_NAME),
        .bDescriptorType = USB_STRING_DESC,
        .bString = EMBEDDED_OUT_INTERNAL_MIDI_IN_NAME,
    },
    .utf16le_EMBEDDED_OUT_EXTERNAL_MIDI_IN = {
        .bLength = USB_STRING_DESCRIPTOR_LENGTH(EMBEDDED_OUT_EXTERNAL_MIDI_IN_NAME),
        .bDescriptorType = USB_STRING_DESC,
        .bString = EMBEDDED_OUT_EXTERNAL_MIDI_IN_NAME,
    },
    .utf16le_EMBEDDED_IN_EXTERNAL_MIDI_OUT = {
        .bLength = USB_STRING_DESCRIPTOR_LENGTH(EMBEDDED_IN_EXTERNAL_MIDI_OUT_NAME),
        .bDescriptorType = USB_STRING_DESC,
        .bString = EMBEDDED_IN_EXTERNAL_MIDI_OUT_NAME,
    },
};

USBD_CLASS_DESCR_DEFINE(primary, midistreaming) struct usb_midi_if_descriptor midi_cfg = {
    .if0={
        .bLength=9,
        .bDescriptorType=USB_INTERFACE_DESC,
        .bInterfaceNumber=0,
        .bAlternateSetting=0,
        .bNumEndpoints=ARRAY_SIZE(ep_cfg),
        .bInterfaceClass=AUDIO_CLASS,
        .bInterfaceSubClass=USB_AUDIO_MIDISTREAMING,
        .bInterfaceProtocol=0,
        .iInterface=0
    },
    .cs_if0=MIDISTREAMING_CONFIG(
        /* === USB-MIDI elements === */
        /* Embedded MIDI from host */
        MIDI_JACKIN_DESCRIPTOR(JACK_EMBEDDED, EMBEDDED_IN_EXTERNAL_MIDI_OUT_ID, 8),
        /* External MIDI OUT socket */
        MIDI_JACKOUT_DESCRIPTOR(JACK_EXTERNAL, EXTERNAL_MIDI_OUT_ID, 5,
            EMBEDDED_IN_EXTERNAL_MIDI_OUT_ID, 1
        ),
        /* External MIDI IN socket */
        MIDI_JACKIN_DESCRIPTOR( JACK_EXTERNAL, EXTERNAL_MIDI_IN_ID, 4),
        /* Embedded MIDI to host from external MIDI */
        MIDI_JACKOUT_DESCRIPTOR(JACK_EMBEDDED, EMBEDDED_OUT_EXTERNAL_MIDI_IN_ID, 7,
            EXTERNAL_MIDI_IN_ID, 1
        ),
        /* Embedded MIDI to host from internal MIDI (sensors) */
        MIDI_JACKOUT_DESCRIPTOR(JACK_EMBEDDED, EMBEDDED_OUT_INTERNAL_MIDI_IN_ID, 6),
        
        /* === USB-MIDI endpoints === */
        /* Bulk endpoint MIDI_IN with 2 embedded MIDI to host */
        MIDI_BULK_ENDPOINT(MIDI_IN_ENDPOINT_ID,
            EMBEDDED_OUT_INTERNAL_MIDI_IN_ID,
            EMBEDDED_OUT_EXTERNAL_MIDI_IN_ID
        ),
        /* Bulk endpointMIDI_OUT with 1 embedded MIDI from host */
        MIDI_BULK_ENDPOINT(MIDI_OUT_ENDPOINT_ID,
            EMBEDDED_IN_EXTERNAL_MIDI_OUT_ID
        ),
    )
};

static void midi_interface_configure(struct usb_desc_header *head, uint8_t bInterfaceNumber)
{
    ARG_UNUSED(head);
    midi_cfg.if0.bInterfaceNumber = bInterfaceNumber;
    LOG_INF("USB MIDI Interface configured: %d", (int) bInterfaceNumber);
}

static enum usb_dc_status_code current_status = 0;

static void midi_status_callback(struct usb_cfg_data *cfg, enum usb_dc_status_code status, const uint8_t *param)
{
    ARG_UNUSED(cfg);
    current_status = status;
    switch (status){
    case USB_DC_ERROR:
        LOG_INF("USB error reported by the controller");
        break;
    case USB_DC_RESET:
        LOG_INF("USB reset");
        break;
    case USB_DC_CONNECTED:
        LOG_INF("USB connection established, hardware enumeration is completed");
        break;
    case USB_DC_CONFIGURED:
        LOG_INF("USB configuration done");
        break;
    case USB_DC_DISCONNECTED:
        LOG_INF("USB connection lost");
        break;
    case USB_DC_SUSPEND:
        LOG_INF("USB connection suspended by the HOST");
        break;
    case USB_DC_RESUME:
        LOG_INF("USB connection resumed by the HOST");
        break;
    case USB_DC_INTERFACE:
        LOG_INF("USB interface selected");
        break;
    case USB_DC_SET_HALT:
        LOG_INF("Set Feature ENDPOINT_HALT received");
        break;
    case USB_DC_CLEAR_HALT:
        LOG_INF("Clear Feature ENDPOINT_HALT received");
        break;
    case USB_DC_SOF:
        LOG_INF("Start of Frame received");
        break;
    case USB_DC_UNKNOWN:
        LOG_INF("Initial USB connection status");
        break;
    }
}

static int midi_vendor_handler(struct usb_setup_packet *setup, int32_t *len, uint8_t **data)
{
    LOG_INF("Class request: bRequest 0x%x bmRequestType 0x%x len %d",
        setup->bRequest, setup->bmRequestType, *len);
    return 0;
}


USBD_CFG_DATA_DEFINE(primary, midistreaming) struct usb_cfg_data midi_config = {
    .usb_device_description=NULL,
    .interface_config=midi_interface_configure,
    .interface_descriptor=&midi_cfg,
    .cb_usb_status=midi_status_callback,
    .interface={
        .class_handler=NULL,
        .custom_handler=NULL,
        .vendor_handler=midi_vendor_handler,
    },
    .num_endpoints=ARRAY_SIZE(ep_cfg),
    .endpoint=ep_cfg,
};


bool usb_midi_is_configured()
{
    return current_status == USB_DC_CONFIGURED;
}

/* === Output stream === */
RING_BUF_ITEM_DECLARE_POW2(usb_midi_to_host_buf, 5);

static void usb_midi_to_host_done(uint8_t ep, int size, void *data)
{
    ARG_UNUSED(ep);
    ARG_UNUSED(data);
    if (size > 0){
        ring_buf_get_finish(&usb_midi_to_host_buf, size);
    } else {
        ring_buf_get_finish(&usb_midi_to_host_buf, 0);
    }
}


bool usb_midi_to_host(uint8_t cable_number, const uint8_t midi_pkt[3])
{
    // Deny sending MIDI to host if USB not configured
    if (! usb_midi_is_configured()){
        return false;
    }

    // Determine the USB-MIDI prefix
    uint8_t cmd = midi_pkt[0] >> 4;
    uint8_t prefix = (cable_number << 4) | cmd;
    uint8_t *queued_data = NULL;

    // Allocate space in tx buffer
    uint32_t requested = 1 + midi_datasize(cmd);
    uint32_t allocated = ring_buf_put_claim(&usb_midi_to_host_buf, &queued_data, requested);
    if (allocated < requested){
        ring_buf_put_finish(&usb_midi_to_host_buf, 0);
        return false;
    }

    // Copy to tx buffer
    queued_data[0] = prefix;
    memcpy(&queued_data[1], midi_pkt, midi_datasize(cmd));

    // Commit transaction
    ring_buf_put_finish(&usb_midi_to_host_buf, allocated);

    // Then initiate USB transfer with all available data
    if (! usb_transfer_is_busy(MIDI_IN_ENDPOINT_ID)){
        uint32_t data_ready = ring_buf_get_claim(&usb_midi_to_host_buf, &queued_data, MIDI_BULK_SIZE);
        if (data_ready > 0){
            usb_transfer(MIDI_IN_ENDPOINT_ID, queued_data, data_ready, USB_TRANS_WRITE, usb_midi_to_host_done, NULL);
        } else {
            ring_buf_get_finish(&usb_midi_to_host_buf, 0);
        }
    }
    return true;
}


/* === Input stream === */
static K_SEM_DEFINE(usb_midi_from_host_sem, 0, 1);
RING_BUF_ITEM_DECLARE_POW2(usb_midi_from_host_buf, 5);

static void usb_midi_from_host_done(uint8_t ep, int size, void *data)
{
    ARG_UNUSED(ep);
    ARG_UNUSED(data);
    if (size > 0){
        ring_buf_put_finish(&usb_midi_from_host_buf, size);
    } else {
        ring_buf_put_finish(&usb_midi_from_host_buf, 0);
    }
    k_sem_give(&usb_midi_from_host_sem);
}

static bool usb_midi_from_host(uint8_t *cable_number, uint8_t midi_pkt[3])
{
    // Attempt to get 1 MIDI packet
    uint8_t *queued_data = NULL;
    uint32_t data_ready = ring_buf_get_claim(&usb_midi_from_host_buf, &queued_data, 4);
    if (data_ready < 2){
        ring_buf_get_finish(&usb_midi_from_host_buf, 0);
        return false;
    }

    // Get packet, and commit transaction
    uint8_t cmd = queued_data[0] & 0xff;
    *cable_number = queued_data[0] >> 4;
    memcpy(midi_pkt, &queued_data[1], midi_datasize(cmd));
    ring_buf_get_finish(&usb_midi_from_host_buf, 1 + midi_datasize(cmd));
    return true;
}

bool usb_midi_wait_from_host(uint8_t *cable_number, uint8_t midi_pkt[3])
{
    if (! usb_midi_is_configured()){
        return false;
    }

    while (! usb_midi_from_host(cable_number, midi_pkt)){
        uint8_t *queued_data = NULL;
        uint32_t allocated = ring_buf_put_claim(&usb_midi_from_host_buf, &queued_data, MIDI_BULK_SIZE);
        if (allocated == 0){
            ring_buf_put_finish(&usb_midi_from_host_buf, 0);
        } else {
            usb_transfer(MIDI_OUT_ENDPOINT_ID, queued_data, allocated, USB_TRANS_READ, usb_midi_from_host_done, NULL);
            k_sem_take(&usb_midi_from_host_sem, K_FOREVER);
        }
    }

    return true;
}
```

## src/usb_midi.h
```c
/**
 * See "Universal Serial Bus Device Class Definition for MIDI Devices", v1.0
 * https://www.usb.org/sites/default/files/midi10.pdf
 * 
 * See "Universal Serial Bus Device Class Definition for Audio Devices", v1.0
 * https://www.usb.org/sites/default/files/audio10.pdf
 */

#ifndef ZEPHYR_INCLUDE_USB_CLASS_USB_MIDI_H_
#define ZEPHYR_INCLUDE_USB_CLASS_USB_MIDI_H_

#include <zephyr.h>
#include <usb/class/usb_audio.h>

#define MIDI_BULK_SIZE 64

// Audio Class-Specific Descriptor Types (audio10, A.4)
#define CS_UNDEFINED     0x20
#define CS_DEVICE        0x21
#define CS_CONFIGURATION 0x22
#define CS_STRING        0x23
#define CS_INTERFACE     0x24
#define CS_ENDPOINT      0x25


// MidiStreaming Class-Specific Interface Descriptor Subtypes (midi10, A.1)
#define MS_DESCRIPTOR_UNDEFINED 0x00
#define MS_HEADER               0x01
#define MIDI_IN_JACK            0x02
#define MIDI_OUT_JACK           0x03
#define ELEMENT                 0x04


// MidiStreaming Class-Specific Endpoint Descriptor Subtypes (midi10, A.2)
#define DESCRIPTOR_UNDEFINED 0x00
#define MS_GENERAL           0x01


// MidiStreaming MIDI IN and OUT Jack types (midi10, A.3)
#define JACK_TYPE_UNDEFINED 0x00
#define JACK_EMBEDDED       0x01
#define JACK_EXTERNAL       0x02


struct usb_midi_if_descriptor {
    struct usb_if_descriptor if0;
    uint8_t cs_if0[];
};

#define N_ELEMS(...) sizeof((uint8_t[]) {__VA_ARGS__})

// Class-Specific MS Interface Header Descriptor (midi10, 6.1.2.1)
#define MIDI_CS_IF(...) \
    7, \
    CS_INTERFACE, \
    MS_HEADER, \
    0x01, 0x00, \
    (7 + N_ELEMS(__VA_ARGS__)) >> 8, \
    7 + N_ELEMS(__VA_ARGS__)


// MIDI IN Jack Descriptor (midi10, 6.1.2.2)
#define MIDI_JACKIN_DESCRIPTOR(bJackType, bJackID, iJack) \
    6, \
    CS_INTERFACE, \
    MIDI_IN_JACK, \
    (bJackType), \
    (bJackID), \
    (iJack)


// MIDI OUT Jack Descriptor (midi10, 6.1.2.3)
#define MIDI_JACKOUT_DESCRIPTOR(bJackType, bJackID, iJack, ...) \
    (7 + N_ELEMS(__VA_ARGS__)), \
    CS_INTERFACE, \
    MIDI_OUT_JACK, \
    (bJackType), \
    (bJackID), \
    N_ELEMS(__VA_ARGS__)/2, \
    ##__VA_ARGS__, \
    (iJack)


// Standard MS Bulk Data Endpoint Descriptor (midi10, 6.2.1)
#define MIDI_STD_BULK_ENDPOINT(bEndpointAddress) \
    9, \
    USB_ENDPOINT_DESC, \
    (bEndpointAddress), \
    USB_DC_EP_BULK, \
    MIDI_BULK_SIZE, 0, \
    0, \
    0, \
    0


// Class-Specific MS Bulk Data Endpoint Descriptor (midi10, 6.2.2)
#define MIDI_CS_BULK_ENDPOINT(...) \
    4 + N_ELEMS(__VA_ARGS__), \
    CS_ENDPOINT, \
    MS_GENERAL, \
    N_ELEMS(__VA_ARGS__), \
    __VA_ARGS__

// Standard + Class-Specific MS Bulk Data Endpoint Descriptor
#define MIDI_BULK_ENDPOINT(bEndpointAddress, ...) \
    MIDI_STD_BULK_ENDPOINT(bEndpointAddress), \
    MIDI_CS_BULK_ENDPOINT(__VA_ARGS__)


// MIDIStreaming interface definition (midi10, 6)
#define MIDISTREAMING_CONFIG(...) \
    { \
        MIDI_CS_IF(__VA_ARGS__), \
        __VA_ARGS__ \
    }

#define MIDI_SYS_COMMON2    0x02
#define MIDI_SYS_COMMON3    0x03
#define MIDI_SYSEX_START    0x04
#define MIDI_SYS_COMMON1    0x05
#define MIDI_SYSEX_2B       0x06
#define MIDI_SYSEX_3B       0x07
#define MIDI_NOTE_OFF       0x08
#define MIDI_NOTE_ON        0x09
#define MIDI_POLY_KEYPRESS  0x0A
#define MIDI_CONTROL_CHANGE 0x0B
#define MIDI_PROGRAM_CHANGE 0x0C
#define MIDI_CHAN_PRESSURE  0x0D
#define MIDI_PITCH_BEND     0x0E
#define MIDI_SINGLE_BYTE    0x0F

static inline size_t midi_datasize(uint8_t evt_type)
{
    switch (evt_type){
        case MIDI_SYS_COMMON1:
        case MIDI_SINGLE_BYTE:
            return 1;
        case MIDI_SYS_COMMON2:
        case MIDI_SYSEX_2B:
        case MIDI_PROGRAM_CHANGE:
        case MIDI_CHAN_PRESSURE:
            return 2;
        default:
            return 3;
    }
}

bool usb_midi_is_configured();

bool usb_midi_to_host(uint8_t cable_number, const uint8_t midi_pkt[3]);

bool usb_midi_wait_from_host(uint8_t *cable_number, uint8_t midi_pkt[3]);

#endif
```
